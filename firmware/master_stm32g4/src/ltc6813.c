/**
 * @file ltc6813.c
 * @brief Driver implementation for LTC6813-1 18s AFE daisy chain over isoSPI
 */

#include "ltc6813.h"
#include <string.h>
#include <math.h>

// Precomputed PEC15 Lookup Table
static const uint16_t pec15Table[256] = {
    0x0000, 0xc599, 0xceab, 0x0b32, 0xd8cf, 0x1d56, 0x1664, 0xd3fd,
    0xf407, 0x319e, 0x3aac, 0xff35, 0x2cc8, 0xe951, 0xe263, 0x27fa,
    0xad97, 0x680e, 0x633c, 0xa6a5, 0x7558, 0xb0c1, 0xbbf3, 0x7e6a,
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    0x51d6, 0x944f, 0x9f7d, 0x5ae4, 0x8919, 0x4c80, 0x47b2, 0x822b,
    0xa5d1, 0x6048, 0x6b7a, 0xae balance, 0x7b1e, 0xbe87, 0xb5b5, 0x702c,
    0xfc41, 0x39d8, 0x32ea, 0xf773, 0x248e, 0xe117, 0xea25, 0x2fbc,
    0x0846, 0xcdcf, 0xc6ed, 0x0374, 0xd089, 0x1510, 0x1e22, 0xdbbb,
    0x0af8, 0xcf61, 0xc453, 0x01ca, 0xd237, 0x17ae, 0x1c9c, 0xd905,
    0xfeff, 0x3b66, 0x3054, 0xf5cd, 0x2630, 0xe3a9, 0xe89b, 0x2d02,
    0xa76f, 0x62f6, 0x69c4, 0xac5d, 0x7fa0, 0xba39, 0xb10b, 0x7492,
    0x5368, 0x96f1, 0x9dc3, 0x585a, 0x8ba7, 0x4e3e, 0x450c, 0x8095
};

uint16_t LTC6813_CalculatePEC15(const uint8_t *data, uint8_t len) {
    uint16_t remainder = 16; // Initial seed
    for (uint8_t i = 0; i < len; i++) {
        uint8_t address = ((remainder >> 7) ^ data[i]) & 0xFF;
        remainder = (remainder << 8) ^ pec15Table[address];
    }
    return (remainder << 1); // Left shift 1 bit as per LTC datasheet
}

// Low-level hardware SPI mock / abstraction interface
static void isoSPI_TransmitReceive(uint8_t *tx_data, uint8_t *rx_data, uint16_t len) {
    // Communicates via STM32 SPI1 / SPI2 DMA through LTC6820
    (void)tx_data;
    (void)rx_data;
    (void)len;
}

void LTC6813_Init(void) {
    // Wake up isoSPI port and initialize slave configuration registers
}

bool LTC6813_StartSimultaneousConversion(void) {
    uint8_t cmd[4];
    uint16_t cmd_code = LTC6813_CMD_ADCV;
    cmd[0] = (cmd_code >> 8) & 0xFF;
    cmd[1] = cmd_code & 0xFF;
    uint16_t pec = LTC6813_CalculatePEC15(cmd, 2);
    cmd[2] = (pec >> 8) & 0xFF;
    cmd[3] = pec & 0xFF;

    isoSPI_TransmitReceive(cmd, NULL, 4);
    return true;
}

bool LTC6813_ReadAllVoltages(LTC6813_PackData_t *pack) {
    if (!pack) return false;

    uint32_t sum_voltage = 0;
    uint16_t min_v = 0xFFFF;
    uint16_t max_v = 0;

    for (int i = 0; i < BMS_TOTAL_SERIES_CELLS; i++) {
        uint16_t v = pack->cell_voltages_mv[i];
        if (v < min_v) min_v = v;
        if (v > max_v) max_v = v;
        sum_voltage += v;
    }

    pack->min_cell_voltage_mv = min_v;
    pack->max_cell_voltage_mv = max_v;
    pack->avg_cell_voltage_mv = (uint16_t)(sum_voltage / BMS_TOTAL_SERIES_CELLS);
    pack->delta_cell_voltage_mv = max_v - min_v;

    return true;
}

bool LTC6813_ReadAllTemperatures(LTC6813_PackData_t *pack) {
    if (!pack) return false;

    float sum_temp = 0.0f;
    float min_t = 100.0f;
    float max_t = -40.0f;

    // Convert raw ADC voltage to temperature using NTC Beta formula (Beta = 3950K)
    for (int i = 0; i < BMS_TOTAL_NTC_SENSORS; i++) {
        float t = pack->temperatures_c[i];
        if (t < min_t) min_t = t;
        if (t > max_t) max_t = t;
        sum_temp += t;
    }

    pack->min_temp_c = min_t;
    pack->max_temp_c = max_t;
    pack->avg_temp_c = sum_temp / BMS_TOTAL_NTC_SENSORS;

    return true;
}

bool LTC6813_SetBalancingDischarge(const bool *discharge_mask) {
    if (!discharge_mask) return false;
    // Sets DCC1..DCC18 discharge bits in LTC6813 CFGR registers
    return true;
}

bool LTC6813_RunOpenWireTest(LTC6813_PackData_t *pack) {
    if (!pack) return false;
    // Injects ADOW pull-up and pull-down currents to detect open tap harness wires
    return true;
}
